## Kconfig
```kconfig
menuconfig ALINK_EMBED_ENABLE
    bool "Enable alink_embed function"
    default y
    help
       If the option is enabled, "ALINK_EMBED" works.

config ALINK_WRITE_NOT_BUFFER
    bool "Remove the buffer space for reporting data"
    default 0
    depends on ALINK_EMBED_ENABLE
    help
        Remove the buffer space for reporting data.

config WIFI_WAIT_TIME
    int "the connection router maximum latency unit is seconds"
    default 60
    depends on ALINK_EMBED_ENABLE
    help
        the connection router maximum latency unit is seconds

config ALINK_TASK_PRIOTY
    int "Configure the priority of all alink tasks"
    default 6
    depends on ALINK_EMBED_ENABLE
    help
        Configure the priority of all alink tasks

config ALINK_EVENT_STACK_SIZE
    int "The maximum length of the transmitted data"
    default 4096
    depends on ALINK_EMBED_ENABLE
    help
        The maximum length of this data is 1536B

config ALINK_POST_DATA_STACK_SIZE
    int "The size of the task of reporting data to Ali"
    default 4096
    depends on ALINK_EMBED_ENABLE
    help
        The size of the task of reporting data to Ali

config DOWN_CMD_QUEUE_NUM
    int "The number of buffered data received"
    default 3
    depends on ALINK_EMBED_ENABLE
    help
        The number of buffered data received

config UP_CMD_QUEUE_NUM
    int "The number of buffered data send"
    default 3
    depends on ALINK_EMBED_ENABLE
    help
        The number of buffered data send

config ALINK_DATA_LEN
    int "The maximum length of the transmitted data"
    default 1024
    depends on ALINK_EMBED_ENABLE
    help
        The maximum length of this data is 1536B

config ALINK_CHIPID
    string "The name of the chip"
    default "esp32"
    depends on ALINK_EMBED_ENABLE
    help
        Before modifying this parameter, make sure that the device is
        unbinded with Ali cloud server

config ALINK_MODULE_NAME
    string "The name of the module"
    default "ESP-WROOM-32"
    depends on ALINK_EMBED_ENABLE
    help
        Before modifying this parameter, make sure that the device is
        unbinded with Ali cloud server

choice LOG_ALINK_LEVEL
    bool "Configure the alink application layer's log"
    default LOG_ALINK_LEVEL_DEBUG
    depends on ALINK_EMBED_ENABLE
    help
       Specify how much output to see in logs by default.
       Note that this setting limits which log statements
       are compiled into the program. So setting this to, say,
       "Warning" would mean that changing log level to "Debug"
       at runtime will not be possible.

config LOG_ALINK_LEVEL_NONE
   bool "No output"
config LOG_ALINK_LEVEL_ERROR
   bool "Error"
config LOG_ALINK_LEVEL_WARN
   bool "Warning"
config LOG_ALINK_LEVEL_INFO
   bool "Info"
config LOG_ALINK_LEVEL_DEBUG
   bool "Debug"
config LOG_ALINK_LEVEL_VERBOSE
   bool "Verbose"
endchoice

config LOG_ALINK_LEVEL
    int
    default 0 if LOG_ALINK_LEVEL_NONE
    default 1 if LOG_ALINK_LEVEL_ERROR
    default 2 if LOG_ALINK_LEVEL_WARN
    default 3 if LOG_ALINK_LEVEL_INFO
    default 4 if LOG_ALINK_LEVEL_DEBUG
    default 5 if LOG_ALINK_LEVEL_VERBOSE
    depends on ALINK_EMBED_ENABLE

choice LOG_ALINK_SDK_LEVEL
    bool "Configure the alink sdk's log"
    default LOG_ALINK_SDK_LEVEL_TRACE
    depends on ALINK_EMBED_ENABLE
    help
       Specify how much output to see in logs by default.
       Note that this setting limits which log statements
       are compiled into the program. So setting this to, say,
       "Warning" would mean that changing log level to "Debug"
       at runtime will not be possible.

config LOG_ALINK_SDK_LEVEL_NONE
   bool "No output"
config LOG_ALINK_SDK_LEVEL_ERROR
   bool "Error"
config LOG_ALINK_SDK_LEVEL_WARN
   bool "Warning"
config LOG_ALINK_SDK_LEVEL_INFO
   bool "Info"
config LOG_ALINK_SDK_LEVEL_DEBUG
   bool "Debug"
config LOG_ALINK_SDK_LEVEL_TRACE
   bool "Trace"
endchoice

config LOG_ALINK_SDK_LEVEL
    int
    default 0 if LOG_ALINK_SDK_LEVEL_NONE
    default 1 if LOG_ALINK_SDK_LEVEL_FATAL
    default 2 if LOG_ALINK_SDK_LEVEL_ERROR
    default 3 if LOG_ALINK_SDK_LEVEL_WARN
    default 4 if LOG_ALINK_SDK_LEVEL_INFO
    default 5 if LOG_ALINK_SDK_LEVEL_DEBUG
    default 6 if LOG_ALINK_SDK_LEVEL_TRACE
    depends on ALINK_EMBED_ENABLE
```
